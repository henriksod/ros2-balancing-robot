## arduino/zephyr/hello_world/test/testcase.yaml
```yaml
# Copyright (c) 2023, Henrik Söderlund

tests:
  testing.common.time:
    build_only: true
    platform_allow: native_posix
    integration_platforms:
      - native_posix
    tags: test_framework
```
